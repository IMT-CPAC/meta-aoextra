## conf/layer.conf
```bitbake
# We have a conf and classes directory, add to BBPATH
BBPATH .= ":${LAYERDIR}"

# We have a recipes-* directories, add to BBFILES
BBFILES += "${LAYERDIR}/recipes-*/*/*.bb \
    ${LAYERDIR}/recipes-*/*/*.bbappend"

BBFILE_COLLECTIONS += "meta-aoextra"
BBFILE_PATTERN_meta-aoextra = "^${LAYERDIR}/"
BBFILE_PRIORITY_meta-aoextra = "6"

LAYERSERIES_COMPAT_meta-aoextra = "rocko sumo thud  gatesgarth"
```
